## Kconfig
```kconfig
# Copyright 2026 Roman Kuzmitskii (@damex)
# SPDX-License-Identifier: MIT

if DT_HAS_ZMK_BEHAVIOR_BUTTON_DIRECT_ENABLED

module = ZMK_BEHAVIOR_BUTTON_DIRECT
module-str = zmk_behavior_button_direct
source "subsys/logging/Kconfig.template.log_config"

endif
```

## dts/bindings/behaviors/zmk,behavior-button-direct.yaml
```yaml
# Copyright 2026 Roman Kuzmitskii (@damex)
# SPDX-License-Identifier: MIT

description: |
  Drain-aware behavior for HID buttons (Button Page 0x09: mouse, joystick, gamepad).
  Param1 is HID button bit mask, same shape as &mkp: LCLK=BIT(0), RCLK=BIT(1),
  MCLK=BIT(2), MB4=BIT(3), MB5=BIT(4), OR'd for multiple. On release, drains ZMK HID
  press count to zero, so release lost in transport self-heals on next click instead of
  leaving button held until power-cycle.

compatible: "zmk,behavior-button-direct"

include: one_param.yaml
```
